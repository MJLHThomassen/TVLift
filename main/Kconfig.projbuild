## main/Kconfig.projbuild
```kconfig
menu "WiFi Settings"
    config WIFI_SSID
        string "WiFi SSID"
        default "myssid"
        help
            SSID (network name) for the program to connect to.

    config WIFI_PASSWORD
        string "WiFi Password"
        default "mypassword"
        help
            WiFi password (WPA or WPA2) for the program to use.
            Can be left blank if the network has no security set.
endmenu
```
